/* SPDX-License-Identifier: (GPL-2.0+ OR MIT) */
/*
 * myd-lmx9x-11x11-custom.dtb —— 产品镜像固定加载的设备树（文件名保持不变）
 *
 * 为什么本文件只是一个 include：
 *   U-Boot 的 fdtfile 与 SWUpdate 内核升级包都写死了这个文件名，不能改名：
 *     - u-boot : board/myir/myd_lmx9x/myd_lmx9x.env
 *                fdtfile=CONFIG_DEFAULT_FDT_FILE（值为 myd-lmx9x-11x11-custom.dtb）
 *     - meta-custom : linux-imx_%.bbappend 的 KERNEL_SWU_DTB、
 *                     swupdate-image-kernel/files/preinstall.sh 的 DTB
 *   所以“一个镜像 + 一个默认 DTB”要跑新板，只能让 custom.dtb 的内容 = 新板配置。
 *   唯一内容源是 myd-lmx9x-11x11-convergence-terminal.dts（Pin List v2），
 *   这里用 include 而不是复制，避免两份 dts 长期漂移。
 *
 * 旧板（Pin List v1）保留为 myd-lmx9x-11x11-custom-v1.dts，现场切换：
 *   U-Boot> setenv fdtfile myd-lmx9x-11x11-custom-v1.dtb; saveenv
 *   （镜像已把两个 dtb 都放进 boot 分区，见 gateway-distro.conf 的 KERNEL_DEVICETREE）
 *
 * 注意：v1/v2 在 ENET1（RMII/RGMII）、指示灯、确认按键等引脚上物理冲突，
 *       不存在能同时描述两块板的单一 DTB。board-init.sh 用本 DTB 的
 *       lpuart6(serial@425a0000) status 判断版本（v1=okay / v2=disabled），
 *       因此 DTB 与实际硬件必须一一对应，不能只刷 dtb 不改板。
 */

#include "myd-lmx9x-11x11-convergence-terminal.dts"
